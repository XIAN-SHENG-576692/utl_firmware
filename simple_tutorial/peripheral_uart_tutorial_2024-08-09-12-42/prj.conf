## CMakeLists.txt
```
#
# Copyright (c) 2018 Nordic Semiconductor
#
# SPDX-License-Identifier: LicenseRef-Nordic-5-Clause
#
cmake_minimum_required(VERSION 3.20.0)

find_package(Zephyr REQUIRED HINTS $ENV{ZEPHYR_BASE})
project(utl_all_in_one)

# NORDIC SDK APP START
target_sources(app PRIVATE
  src/main.c
  src/device/device_ble.c
  src/device/device_buttons.c
  src/device/device_lights.c
  src/driver/driver_uart.c
  src/task/task_ble.c
  src/task/task_buttons.c
  src/task/task_thread.c
  src/utility/utility_sleep.c
)

# Include UART ASYNC API adapter
target_sources_ifdef(CONFIG_BT_NUS_UART_ASYNC_ADAPTER app PRIVATE
  src/driver/uart_async_adapter.c
)

# NORDIC SDK APP END

zephyr_library_include_directories(
  .
  ./src
  ./src/device
  ./src/driver
  ./src/task
  ./src/utility
)
```

## prj.conf
```kconfig
#
# Copyright (c) 2018 Nordic Semiconductor
#
# SPDX-License-Identifier: LicenseRef-Nordic-5-Clause
#

# Enable the UART driver
CONFIG_UART_ASYNC_API=y
CONFIG_NRFX_UARTE0=y
CONFIG_SERIAL=y

CONFIG_GPIO=y

# Make sure printk is printing to the UART console
CONFIG_CONSOLE=y
CONFIG_UART_CONSOLE=y

CONFIG_HEAP_MEM_POOL_SIZE=2048

CONFIG_BT=y
CONFIG_BT_PERIPHERAL=y
CONFIG_BT_DEVICE_NAME="Nordic_UART_Service"
CONFIG_BT_MAX_CONN=1
CONFIG_BT_MAX_PAIRED=1

# Enable the NUS service
CONFIG_BT_NUS=y

# Enable bonding
CONFIG_BT_SETTINGS=y
CONFIG_FLASH=y
CONFIG_FLASH_PAGE_LAYOUT=y
CONFIG_FLASH_MAP=y
CONFIG_NVS=y
CONFIG_SETTINGS=y

# Enable DK LED and Buttons library
CONFIG_DK_LIBRARY=y

# This example requires more stack
CONFIG_MAIN_STACK_SIZE=1152
CONFIG_SYSTEM_WORKQUEUE_STACK_SIZE=2048

# Config logger
CONFIG_LOG=y
CONFIG_USE_SEGGER_RTT=y
CONFIG_LOG_BACKEND_RTT=y
CONFIG_LOG_BACKEND_UART=n
CONFIG_LOG_PRINTK=n

CONFIG_ASSERT=y

CONFIG_CLOCK_CONTROL_NRF_K32SRC_RC=y
```

## src/main.c
```c
/*
 * Copyright (c) 2018 Nordic Semiconductor ASA
 *
 * SPDX-License-Identifier: LicenseRef-Nordic-5-Clause
 */

/** @file
 *  @brief Nordic UART Bridge Service (NUS) sample
 */

#include <zephyr/types.h>

#include <zephyr/device.h>
#include <zephyr/devicetree.h>
#include <soc.h>

#include <stdio.h>

#include <zephyr/logging/log.h>
#define LOG_MODULE_NAME main
LOG_MODULE_REGISTER(LOG_MODULE_NAME);

#include "device_ble.h"
#include "device_buttons.h"
#include "device_lights.h"
#include "utility_sleep.h"

#define RUN_LED_BLINK_INTERVAL 1000

void error(void)
{
	device_lights_error();

	while (true) {
		/* Spin for ever */
		utility_sleep(1000);
	}
}

int main(void)
{
	int blink_status = 0;
	int err = 0;

	device_lights_init();
	device_buttons_init();

	err = device_ble_init();
	if (err) {
		error();
	}

	for (;;) {
		device_lights_red_led((++blink_status) % 2);
		utility_sleep(RUN_LED_BLINK_INTERVAL);
	}
}
```
